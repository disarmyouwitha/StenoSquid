#include <behaviors/steno_squid_status.dtsi>
#include <zephyr/dt-bindings/gpio/gpio.h>

/ {
    ext_power {
        compatible = "zmk,ext-power-generic";
        control-gpios = <&gpio0 31 GPIO_ACTIVE_HIGH>;
    };

};
