#include "../corne.keymap"

&{/keymap} {
    // Spare layers that ZMK Studio can hand out. Builds without Studio ignore
    // them. Keep them last so the layers before them keep their IDs.
    extra1 {
        status = "reserved";
    };

    extra2 {
        status = "reserved";
    };
};
