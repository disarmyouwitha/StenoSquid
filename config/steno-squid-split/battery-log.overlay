/* Opt-in overlay for the left half's battery logger. Use it with
 * battery-log.conf; see tools/steno-squid-battery/README.md.
 *
 * Reserves the top 128 KiB of application space for the log. The ZMK
 * settings partition and the bootloader retain their original addresses.
 */
&code_partition {
    reg = <0x26000 0xa6000>;
};

&{/soc/flash-controller@4001e000/flash@0/partitions} {
    battery_log_partition: partition@cc000 {
        label = "battery-log";
        reg = <0xcc000 0x20000>;
    };
};
