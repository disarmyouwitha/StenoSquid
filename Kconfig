## Kconfig
```kconfig
menu "Javelin Steno Engine"

config ZMK_JAVELIN_STENO
    bool "Enable Javelin steno engine"
    default n
    select ZMK_JAVELIN_STENO_EXTERNAL_FLASH if ZMK_SPLIT_ROLE_CENTRAL
    select CPP
    select REQUIRES_FULL_LIBCPP

if ZMK_JAVELIN_STENO

config ZMK_JAVELIN_STENO_EXTERNAL_FLASH
    bool "Use the Steno Squid's external QSPI dictionaries"
    depends on SOC_NRF52840 && ZMK_SLEEP && ZMK_SPLIT_ROLE_CENTRAL
    select NRFX_QSPI
    select CRC

config ZMK_JAVELIN_SERIAL_CONSOLE
    bool "Diagnostic commands on the USB logging serial port"
    select UART_INTERRUPT_DRIVEN
    depends on ZMK_JAVELIN_STENO_EXTERNAL_FLASH && ZMK_USB_LOGGING
    help
      Enable from the diagnostic build's logging.conf with the zmk-usb-logging
      snippet. Everyday builds use wired USB HID for dictionary maintenance.

config ZMK_JAVELIN_DIAG
    bool "Diagnostics on the logging serial port"
    depends on ZMK_JAVELIN_SERIAL_CONSOLE
    select HWINFO
    default y
    help
      Adds a boot log that survives a soft reset, a status command, fault
      counters saved across reboots, and wake timing for the external flash.
      Serial commands: S status, D dump the boot log, Z clear log and counters.
      It compiles only with the logging snippet. The implementation is in
      src/steno_squid/flash_diagnostics.c.

config ZMK_JAVELIN_DICTIONARY_BENCHMARK
    bool "Read-only dictionary measurements and real key-path traces" if ZMK_JAVELIN_DIAG
    depends on ZMK_JAVELIN_STENO_BROWSER_DICTIONARY
    select INIT_STACKS
    select THREAD_STACK_INFO
    help
      Phase-0 instrumentation for diagnostic builds only. Benchmark commands
      use USB HID and never import, erase or change dictionary selections.

config ZMK_STENO_SQUID_REPLAY_DIAGNOSTICS
    bool "Paced dictionary stress replay and retained crash diagnostics"
    depends on ZMK_JAVELIN_STENO_BROWSER_DICTIONARY && ZMK_STENO_SQUID_NATIVE_STORE
    select ZMK_JAVELIN_DICTIONARY_BENCHMARK
    select REBOOT
    help
      Adds USB-only diagnostic commands for paced input and crash capture.

config ZMK_STENO_SQUID_BOOT_PROFILE
    bool "Native dictionary startup profiling"
    depends on ZMK_STENO_SQUID_NATIVE_STORE
    help
      Records startup stages and logical flash reads for USB lab measurements.

config ZMK_STENO_SQUID_BOOT_DMA_READ_AHEAD
    bool "Use paged QSPI DMA during dictionary startup validation"
    depends on ZMK_STENO_SQUID_BOOT_PROFILE
    help
      Lab-only startup read path. Reuses the existing QSPI bounce buffer and
      uses Zephyr's table-driven implementation of the same CRC32.

config ZMK_STENO_SQUID_BOOT_REUSE_LIVE_RECOVERY
    bool "Reuse journal recovery from startup validation"
    depends on ZMK_STENO_SQUID_BOOT_PROFILE
    help
      Lab-only startup optimization. Stage the live journal during full
      validation, and attach it after the catalog selects the validated root.

config ZMK_STENO_SQUID_BOOT_INDEX_BATCH
    bool "Batch journal key reads during startup index validation"
    depends on ZMK_STENO_SQUID_BOOT_PROFILE

config ZMK_STENO_SQUID_BOOT_JOURNAL_DMA
    bool "Use DMA read-ahead for sequential startup journal recovery"
    depends on ZMK_STENO_SQUID_BOOT_REUSE_LIVE_RECOVERY && !ZMK_STENO_SQUID_BOOT_DMA_READ_AHEAD

config ZMK_STENO_SQUID_BOOT_HFXO
    bool "Hold the high-frequency crystal during flash startup"
    depends on ZMK_STENO_SQUID_BOOT_PROFILE && CLOCK_CONTROL_NRF
    help
      Trial workaround for nRF52840 anomaly 244. Keep the clock source stable
      during QSPI bring-up and dictionary validation.

config ZMK_STENO_SQUID_BOOT_FAST_CRC
    bool "Use table-driven IEEE CRC32 in the Native store"
    depends on ZMK_STENO_SQUID_BOOT_PROFILE

config ZMK_STENO_SQUID_BOOT_JOURNAL_BLOCKS
    bool "Use larger sequential journal DMA blocks during startup"
    depends on ZMK_STENO_SQUID_BOOT_JOURNAL_DMA

config ZMK_JAVELIN_DIAG_RAIL_SENSE_PIN
    int "Port 0 pin that the R rail test reads"
    depends on ZMK_JAVELIN_DIAG
    range -1 31
    default -1
    help
      The R serial command switches the flash rail and reads this pin to see
      the rail rise and fall. Use the pin that the 10 k pull-up on the Steno
      Squid ties to the switched rail, which is chip select. The locked
      Boardsource map has it on P0.07. A handwired board may differ.

config ZMK_JAVELIN_STENO_QSPI_SCK_DIVIDER
    int "External flash clock divider (32 MHz / n)"
    depends on ZMK_JAVELIN_STENO_EXTERNAL_FLASH
    range 1 16
    default 1
    help
      The default divider of 1 runs the external flash at 32 MHz.
      Increase the divider for hardware that needs a slower clock.
      A divider of 16 gives 2 MHz.

config ZMK_JAVELIN_STENO_FLASH_SETTLE_MS
    int "External flash rail settle time in milliseconds"
    depends on ZMK_JAVELIN_STENO_EXTERNAL_FLASH
    range 1 1000
    default 50
    help
      Keep the proven 50 ms default until rail rise time has been measured
      on the actual board. Changing this requires hardware validation.

config ZMK_JAVELIN_STENO_FLASH_IDLE_OFF
    bool "Power the external flash down while the dictionaries are idle"
    depends on ZMK_JAVELIN_STENO_EXTERNAL_FLASH
    default y
    help
      Switch the flash rail and QSPI off after a period with no dictionary
      use, except while the steno layer is selected. Selecting that layer
      powers it back up with the quick check, and so does an editor command,
      which waits while the flash starts. Set to n to keep the flash on
      whenever the keyboard is awake.

config ZMK_JAVELIN_STENO_FLASH_IDLE_SECONDS
    int "Seconds without dictionary use before the flash powers down"
    depends on ZMK_JAVELIN_STENO_FLASH_IDLE_OFF
    range 5 3600
    default 30

config ZMK_JAVELIN_STENO_BROWSER_DICTIONARY
    bool "Edit the personal dictionary over Javelin WebHID"
    depends on ZMK_JAVELIN_STENO_EXTERNAL_FLASH
    depends on USB_DEVICE_STACK && USB_HID_DEVICE_COUNT >= 3

config ZMK_STENO_SQUID_NATIVE_STORE
    def_bool ZMK_JAVELIN_STENO_EXTERNAL_FLASH

config ZMK_STENO_SQUID_NATIVE_DICTIONARIES
    int "Maximum resident native dictionary wrappers"
    depends on ZMK_STENO_SQUID_NATIVE_STORE
    range 7 64
    default 16

config ZMK_JAVELIN_STENO_HID_PROVISIONING
    bool "Manage Native dictionary flash through the HID console"
    select BASE64
    depends on ZMK_JAVELIN_STENO_BROWSER_DICTIONARY
    default y

config ZMK_STENO_SQUID_MEMORY_DIAGNOSTICS
    bool "Heap and stack high-water measurement (USB console command memory_report)"
    depends on ZMK_JAVELIN_STENO_BROWSER_DICTIONARY
    select INIT_STACKS
    select THREAD_STACK_INFO
    select THREAD_MONITOR
    select THREAD_NAME
    select SYS_HEAP_RUNTIME_STATS
    default n
    help
      Fills every stack with a pattern and counts the system heap peak, then reports both
      through the USB-only "memory_report" console command. Measurement builds only: thread
      names and the fill add a little RAM and boot time. Use tools/bench/run_memory_report.py.

config ZMK_STENO_SQUID_TRANSFER_SESSION
    bool "Experimental binary transfer session for Native dictionary updates"
    depends on ZMK_JAVELIN_STENO_HID_PROVISIONING && ZMK_STENO_SQUID_NATIVE_STORE
    default n
    help
      Accept CRC-framed binary uploads (first byte 0xB5) on the existing Javelin
      console report, USB and Bluetooth, and stream them into an already-open
      staged Native update. The text console, Base64 commands, storage formats
      and recovery paths are unchanged, and the Manager falls back to them when
      "native_install update transfer-capabilities" is not answered. Costs about
      0.9 KiB of SRAM (decoder, session, page buffer). Not for release builds
      until reviewed; see docs/transfer-session.md.

config ZMK_JAVELIN_STENO_BLE_HID
    bool "Expose the Javelin browser console over Bluetooth HID"
    depends on ZMK_JAVELIN_STENO_BROWSER_DICTIONARY && ZMK_BLE
    help
      Add an encrypted HID over GATT console using Javelin's existing WebHID
      report format. The browser tools require no website modifications.

config ZMK_JAVELIN_BATTERY_LOG
    bool "Record Steno Squid battery samples in a dedicated internal flash partition"
    depends on ZMK_JAVELIN_STENO_EXTERNAL_FLASH && ZMK_JAVELIN_SERIAL_CONSOLE
    depends on ZMK_BLE && FLASH_MAP && HWINFO
    select FCB
    default n
    help
      Needs the battery-log partition from
      config/nicenano-wireless-corne/logging.overlay, which shrinks the
      application partition by 128 KiB. Build with that overlay and
      logging.conf together, as the NiceNano-Left-Diagnostic CI job does.

config ZMK_JAVELIN_STENO_HOST_LAYOUTS
    bool "Choose the host layout (Mac U.S. or Windows U.S.) from the browser tool"
    depends on ZMK_JAVELIN_STENO_BROWSER_DICTIONARY
    help
      Adds the Mac U.S./ABC and Windows U.S. (plain text) profiles and the
      Host Layout picker in Javelin Steno Tools. The choice is saved in ZMK
      settings. ASCII keys use Javelin's US layout in both profiles.

endif # ZMK_JAVELIN_STENO

endmenu

config ZMK_STENO_SQUID_SPLIT_STATUS
    bool "Sync the Steno Squid layer to the right-half nice!view"
    depends on ZMK_SPLIT && ZMK_SPLIT_BLE
    depends on ZMK_SPLIT_ROLE_CENTRAL || (ZMK_DISPLAY && SHIELD_NICE_VIEW && ZMK_DISPLAY_STATUS_SCREEN_CUSTOM)

config ZMK_STENO_SQUID_STROKE_TAPE
    bool "Show the last stroke, its translation and WPM on the right nice!view"
    depends on ZMK_STENO_SQUID_SPLIT_STATUS
    default y
    help
      On the Javelin layer the left half sends each stroke's keys, its
      translation and the typing speed to the right display. This costs one
      small write on the split link per stroke, plus one for a translation
      longer than four characters.

config ZMK_STENO_SQUID_STROKE_HINT
    bool
    depends on ZMK_STENO_SQUID_STROKE_TAPE && ZMK_JAVELIN_STENO && ZMK_SPLIT_ROLE_CENTRAL
    depends on ZMK_JAVELIN_STENO_BROWSER_DICTIONARY
    default y
    help
      Suggest a one-stroke shortcut using the sorted index in freshly compiled
      external dictionary images. Personal dictionaries use native reverse
      lookup. Work runs on the key thread. With ZMK_JAVELIN_DIAG (the logging
      build) each stroke's handling time is logged.

config ZMK_STENO_SQUID_PRACTICE
    bool "Offline single-stroke practice on the right nice!view"
    depends on SETTINGS
    depends on ZMK_STENO_SQUID_SPLIT_STATUS && ZMK_JAVELIN_STENO && ZMK_SPLIT_ROLE_CENTRAL

# Practice publishes several split frames per prompt.
config ZMK_SPLIT_BLE_CENTRAL_SPLIT_RUN_QUEUE_SIZE
    default 40 if ZMK_STENO_SQUID_PRACTICE
```
